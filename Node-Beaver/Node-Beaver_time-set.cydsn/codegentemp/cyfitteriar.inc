#ifndef INCLUDED_CYFITTERIAR_INC
#define INCLUDED_CYFITTERIAR_INC
    INCLUDE cydeviceiar.inc
    INCLUDE cydeviceiar_trm.inc

/* rtc_i2c_I2C_FF */
rtc_i2c_I2C_FF__ADR EQU CYREG_I2C_ADR
rtc_i2c_I2C_FF__CFG EQU CYREG_I2C_CFG
rtc_i2c_I2C_FF__CLK_DIV1 EQU CYREG_I2C_CLK_DIV1
rtc_i2c_I2C_FF__CLK_DIV2 EQU CYREG_I2C_CLK_DIV2
rtc_i2c_I2C_FF__CSR EQU CYREG_I2C_CSR
rtc_i2c_I2C_FF__D EQU CYREG_I2C_D
rtc_i2c_I2C_FF__MCSR EQU CYREG_I2C_MCSR
rtc_i2c_I2C_FF__PM_ACT_CFG EQU CYREG_PM_ACT_CFG5
rtc_i2c_I2C_FF__PM_ACT_MSK EQU 0x04
rtc_i2c_I2C_FF__PM_STBY_CFG EQU CYREG_PM_STBY_CFG5
rtc_i2c_I2C_FF__PM_STBY_MSK EQU 0x04
rtc_i2c_I2C_FF__TMOUT_CFG0 EQU CYREG_I2C_TMOUT_CFG0
rtc_i2c_I2C_FF__TMOUT_CFG1 EQU CYREG_I2C_TMOUT_CFG1
rtc_i2c_I2C_FF__TMOUT_CSR EQU CYREG_I2C_TMOUT_CSR
rtc_i2c_I2C_FF__TMOUT_SR EQU CYREG_I2C_TMOUT_SR
rtc_i2c_I2C_FF__XCFG EQU CYREG_I2C_XCFG

/* rtc_i2c_I2C_IRQ */
rtc_i2c_I2C_IRQ__INTC_CLR_EN_REG EQU CYREG_NVIC_CLRENA0
rtc_i2c_I2C_IRQ__INTC_CLR_PD_REG EQU CYREG_NVIC_CLRPEND0
rtc_i2c_I2C_IRQ__INTC_MASK EQU 0x8000
rtc_i2c_I2C_IRQ__INTC_NUMBER EQU 15
rtc_i2c_I2C_IRQ__INTC_PRIOR_NUM EQU 7
rtc_i2c_I2C_IRQ__INTC_PRIOR_REG EQU CYREG_NVIC_PRI_15
rtc_i2c_I2C_IRQ__INTC_SET_EN_REG EQU CYREG_NVIC_SETENA0
rtc_i2c_I2C_IRQ__INTC_SET_PD_REG EQU CYREG_NVIC_SETPEND0

/* RTC_SCL_1 */
RTC_SCL_1__0__INTTYPE EQU CYREG_PICU2_INTTYPE5
RTC_SCL_1__0__MASK EQU 0x20
RTC_SCL_1__0__PC EQU CYREG_PRT2_PC5
RTC_SCL_1__0__PORT EQU 2
RTC_SCL_1__0__SHIFT EQU 5
RTC_SCL_1__AG EQU CYREG_PRT2_AG
RTC_SCL_1__AMUX EQU CYREG_PRT2_AMUX
RTC_SCL_1__BIE EQU CYREG_PRT2_BIE
RTC_SCL_1__BIT_MASK EQU CYREG_PRT2_BIT_MASK
RTC_SCL_1__BYP EQU CYREG_PRT2_BYP
RTC_SCL_1__CTL EQU CYREG_PRT2_CTL
RTC_SCL_1__DM0 EQU CYREG_PRT2_DM0
RTC_SCL_1__DM1 EQU CYREG_PRT2_DM1
RTC_SCL_1__DM2 EQU CYREG_PRT2_DM2
RTC_SCL_1__DR EQU CYREG_PRT2_DR
RTC_SCL_1__INP_DIS EQU CYREG_PRT2_INP_DIS
RTC_SCL_1__INTTYPE_BASE EQU CYDEV_PICU_INTTYPE_PICU2_BASE
RTC_SCL_1__LCD_COM_SEG EQU CYREG_PRT2_LCD_COM_SEG
RTC_SCL_1__LCD_EN EQU CYREG_PRT2_LCD_EN
RTC_SCL_1__MASK EQU 0x20
RTC_SCL_1__PORT EQU 2
RTC_SCL_1__PRT EQU CYREG_PRT2_PRT
RTC_SCL_1__PRTDSI__CAPS_SEL EQU CYREG_PRT2_CAPS_SEL
RTC_SCL_1__PRTDSI__DBL_SYNC_IN EQU CYREG_PRT2_DBL_SYNC_IN
RTC_SCL_1__PRTDSI__OE_SEL0 EQU CYREG_PRT2_OE_SEL0
RTC_SCL_1__PRTDSI__OE_SEL1 EQU CYREG_PRT2_OE_SEL1
RTC_SCL_1__PRTDSI__OUT_SEL0 EQU CYREG_PRT2_OUT_SEL0
RTC_SCL_1__PRTDSI__OUT_SEL1 EQU CYREG_PRT2_OUT_SEL1
RTC_SCL_1__PRTDSI__SYNC_OUT EQU CYREG_PRT2_SYNC_OUT
RTC_SCL_1__PS EQU CYREG_PRT2_PS
RTC_SCL_1__SHIFT EQU 5
RTC_SCL_1__SLW EQU CYREG_PRT2_SLW

/* RTC_SDA_1 */
RTC_SDA_1__0__INTTYPE EQU CYREG_PICU2_INTTYPE6
RTC_SDA_1__0__MASK EQU 0x40
RTC_SDA_1__0__PC EQU CYREG_PRT2_PC6
RTC_SDA_1__0__PORT EQU 2
RTC_SDA_1__0__SHIFT EQU 6
RTC_SDA_1__AG EQU CYREG_PRT2_AG
RTC_SDA_1__AMUX EQU CYREG_PRT2_AMUX
RTC_SDA_1__BIE EQU CYREG_PRT2_BIE
RTC_SDA_1__BIT_MASK EQU CYREG_PRT2_BIT_MASK
RTC_SDA_1__BYP EQU CYREG_PRT2_BYP
RTC_SDA_1__CTL EQU CYREG_PRT2_CTL
RTC_SDA_1__DM0 EQU CYREG_PRT2_DM0
RTC_SDA_1__DM1 EQU CYREG_PRT2_DM1
RTC_SDA_1__DM2 EQU CYREG_PRT2_DM2
RTC_SDA_1__DR EQU CYREG_PRT2_DR
RTC_SDA_1__INP_DIS EQU CYREG_PRT2_INP_DIS
RTC_SDA_1__INTTYPE_BASE EQU CYDEV_PICU_INTTYPE_PICU2_BASE
RTC_SDA_1__LCD_COM_SEG EQU CYREG_PRT2_LCD_COM_SEG
RTC_SDA_1__LCD_EN EQU CYREG_PRT2_LCD_EN
RTC_SDA_1__MASK EQU 0x40
RTC_SDA_1__PORT EQU 2
RTC_SDA_1__PRT EQU CYREG_PRT2_PRT
RTC_SDA_1__PRTDSI__CAPS_SEL EQU CYREG_PRT2_CAPS_SEL
RTC_SDA_1__PRTDSI__DBL_SYNC_IN EQU CYREG_PRT2_DBL_SYNC_IN
RTC_SDA_1__PRTDSI__OE_SEL0 EQU CYREG_PRT2_OE_SEL0
RTC_SDA_1__PRTDSI__OE_SEL1 EQU CYREG_PRT2_OE_SEL1
RTC_SDA_1__PRTDSI__OUT_SEL0 EQU CYREG_PRT2_OUT_SEL0
RTC_SDA_1__PRTDSI__OUT_SEL1 EQU CYREG_PRT2_OUT_SEL1
RTC_SDA_1__PRTDSI__SYNC_OUT EQU CYREG_PRT2_SYNC_OUT
RTC_SDA_1__PS EQU CYREG_PRT2_PS
RTC_SDA_1__SHIFT EQU 6
RTC_SDA_1__SLW EQU CYREG_PRT2_SLW

/* timer_clock */
timer_clock__CFG0 EQU CYREG_CLKDIST_DCFG0_CFG0
timer_clock__CFG1 EQU CYREG_CLKDIST_DCFG0_CFG1
timer_clock__CFG2 EQU CYREG_CLKDIST_DCFG0_CFG2
timer_clock__CFG2_SRC_SEL_MASK EQU 0x07
timer_clock__INDEX EQU 0x00
timer_clock__PM_ACT_CFG EQU CYREG_PM_ACT_CFG2
timer_clock__PM_ACT_MSK EQU 0x01
timer_clock__PM_STBY_CFG EQU CYREG_PM_STBY_CFG2
timer_clock__PM_STBY_MSK EQU 0x01

/* millis_timer_TimerUDB */
millis_timer_TimerUDB_rstSts_stsreg__0__MASK EQU 0x01
millis_timer_TimerUDB_rstSts_stsreg__0__POS EQU 0
millis_timer_TimerUDB_rstSts_stsreg__16BIT_STATUS_AUX_CTL_REG EQU CYREG_B0_UDB12_13_ACTL
millis_timer_TimerUDB_rstSts_stsreg__16BIT_STATUS_REG EQU CYREG_B0_UDB12_13_ST
millis_timer_TimerUDB_rstSts_stsreg__2__MASK EQU 0x04
millis_timer_TimerUDB_rstSts_stsreg__2__POS EQU 2
millis_timer_TimerUDB_rstSts_stsreg__3__MASK EQU 0x08
millis_timer_TimerUDB_rstSts_stsreg__3__POS EQU 3
millis_timer_TimerUDB_rstSts_stsreg__MASK EQU 0x0D
millis_timer_TimerUDB_rstSts_stsreg__MASK_REG EQU CYREG_B0_UDB12_MSK
millis_timer_TimerUDB_rstSts_stsreg__STATUS_AUX_CTL_REG EQU CYREG_B0_UDB12_ACTL
millis_timer_TimerUDB_rstSts_stsreg__STATUS_REG EQU CYREG_B0_UDB12_ST
millis_timer_TimerUDB_sCTRLReg_SyncCtl_ctrlreg__16BIT_CONTROL_AUX_CTL_REG EQU CYREG_B0_UDB11_12_ACTL
millis_timer_TimerUDB_sCTRLReg_SyncCtl_ctrlreg__16BIT_CONTROL_CONTROL_REG EQU CYREG_B0_UDB11_12_CTL
millis_timer_TimerUDB_sCTRLReg_SyncCtl_ctrlreg__16BIT_CONTROL_COUNT_REG EQU CYREG_B0_UDB11_12_CTL
millis_timer_TimerUDB_sCTRLReg_SyncCtl_ctrlreg__16BIT_COUNT_CONTROL_REG EQU CYREG_B0_UDB11_12_CTL
millis_timer_TimerUDB_sCTRLReg_SyncCtl_ctrlreg__16BIT_COUNT_COUNT_REG EQU CYREG_B0_UDB11_12_CTL
millis_timer_TimerUDB_sCTRLReg_SyncCtl_ctrlreg__16BIT_MASK_MASK_REG EQU CYREG_B0_UDB11_12_MSK
millis_timer_TimerUDB_sCTRLReg_SyncCtl_ctrlreg__16BIT_MASK_PERIOD_REG EQU CYREG_B0_UDB11_12_MSK
millis_timer_TimerUDB_sCTRLReg_SyncCtl_ctrlreg__16BIT_PERIOD_MASK_REG EQU CYREG_B0_UDB11_12_MSK
millis_timer_TimerUDB_sCTRLReg_SyncCtl_ctrlreg__16BIT_PERIOD_PERIOD_REG EQU CYREG_B0_UDB11_12_MSK
millis_timer_TimerUDB_sCTRLReg_SyncCtl_ctrlreg__7__MASK EQU 0x80
millis_timer_TimerUDB_sCTRLReg_SyncCtl_ctrlreg__7__POS EQU 7
millis_timer_TimerUDB_sCTRLReg_SyncCtl_ctrlreg__CONTROL_AUX_CTL_REG EQU CYREG_B0_UDB11_ACTL
millis_timer_TimerUDB_sCTRLReg_SyncCtl_ctrlreg__CONTROL_REG EQU CYREG_B0_UDB11_CTL
millis_timer_TimerUDB_sCTRLReg_SyncCtl_ctrlreg__CONTROL_ST_REG EQU CYREG_B0_UDB11_ST_CTL
millis_timer_TimerUDB_sCTRLReg_SyncCtl_ctrlreg__COUNT_REG EQU CYREG_B0_UDB11_CTL
millis_timer_TimerUDB_sCTRLReg_SyncCtl_ctrlreg__COUNT_ST_REG EQU CYREG_B0_UDB11_ST_CTL
millis_timer_TimerUDB_sCTRLReg_SyncCtl_ctrlreg__MASK EQU 0x80
millis_timer_TimerUDB_sCTRLReg_SyncCtl_ctrlreg__MASK_CTL_AUX_CTL_REG EQU CYREG_B0_UDB11_MSK_ACTL
millis_timer_TimerUDB_sCTRLReg_SyncCtl_ctrlreg__PER_CTL_AUX_CTL_REG EQU CYREG_B0_UDB11_MSK_ACTL
millis_timer_TimerUDB_sCTRLReg_SyncCtl_ctrlreg__PERIOD_REG EQU CYREG_B0_UDB11_MSK
millis_timer_TimerUDB_sT24_timerdp_u0__16BIT_A0_REG EQU CYREG_B0_UDB10_11_A0
millis_timer_TimerUDB_sT24_timerdp_u0__16BIT_A1_REG EQU CYREG_B0_UDB10_11_A1
millis_timer_TimerUDB_sT24_timerdp_u0__16BIT_D0_REG EQU CYREG_B0_UDB10_11_D0
millis_timer_TimerUDB_sT24_timerdp_u0__16BIT_D1_REG EQU CYREG_B0_UDB10_11_D1
millis_timer_TimerUDB_sT24_timerdp_u0__16BIT_DP_AUX_CTL_REG EQU CYREG_B0_UDB10_11_ACTL
millis_timer_TimerUDB_sT24_timerdp_u0__16BIT_F0_REG EQU CYREG_B0_UDB10_11_F0
millis_timer_TimerUDB_sT24_timerdp_u0__16BIT_F1_REG EQU CYREG_B0_UDB10_11_F1
millis_timer_TimerUDB_sT24_timerdp_u0__A0_A1_REG EQU CYREG_B0_UDB10_A0_A1
millis_timer_TimerUDB_sT24_timerdp_u0__A0_REG EQU CYREG_B0_UDB10_A0
millis_timer_TimerUDB_sT24_timerdp_u0__A1_REG EQU CYREG_B0_UDB10_A1
millis_timer_TimerUDB_sT24_timerdp_u0__D0_D1_REG EQU CYREG_B0_UDB10_D0_D1
millis_timer_TimerUDB_sT24_timerdp_u0__D0_REG EQU CYREG_B0_UDB10_D0
millis_timer_TimerUDB_sT24_timerdp_u0__D1_REG EQU CYREG_B0_UDB10_D1
millis_timer_TimerUDB_sT24_timerdp_u0__DP_AUX_CTL_REG EQU CYREG_B0_UDB10_ACTL
millis_timer_TimerUDB_sT24_timerdp_u0__F0_F1_REG EQU CYREG_B0_UDB10_F0_F1
millis_timer_TimerUDB_sT24_timerdp_u0__F0_REG EQU CYREG_B0_UDB10_F0
millis_timer_TimerUDB_sT24_timerdp_u0__F1_REG EQU CYREG_B0_UDB10_F1
millis_timer_TimerUDB_sT24_timerdp_u1__16BIT_A0_REG EQU CYREG_B0_UDB11_12_A0
millis_timer_TimerUDB_sT24_timerdp_u1__16BIT_A1_REG EQU CYREG_B0_UDB11_12_A1
millis_timer_TimerUDB_sT24_timerdp_u1__16BIT_D0_REG EQU CYREG_B0_UDB11_12_D0
millis_timer_TimerUDB_sT24_timerdp_u1__16BIT_D1_REG EQU CYREG_B0_UDB11_12_D1
millis_timer_TimerUDB_sT24_timerdp_u1__16BIT_DP_AUX_CTL_REG EQU CYREG_B0_UDB11_12_ACTL
millis_timer_TimerUDB_sT24_timerdp_u1__16BIT_F0_REG EQU CYREG_B0_UDB11_12_F0
millis_timer_TimerUDB_sT24_timerdp_u1__16BIT_F1_REG EQU CYREG_B0_UDB11_12_F1
millis_timer_TimerUDB_sT24_timerdp_u1__A0_A1_REG EQU CYREG_B0_UDB11_A0_A1
millis_timer_TimerUDB_sT24_timerdp_u1__A0_REG EQU CYREG_B0_UDB11_A0
millis_timer_TimerUDB_sT24_timerdp_u1__A1_REG EQU CYREG_B0_UDB11_A1
millis_timer_TimerUDB_sT24_timerdp_u1__D0_D1_REG EQU CYREG_B0_UDB11_D0_D1
millis_timer_TimerUDB_sT24_timerdp_u1__D0_REG EQU CYREG_B0_UDB11_D0
millis_timer_TimerUDB_sT24_timerdp_u1__D1_REG EQU CYREG_B0_UDB11_D1
millis_timer_TimerUDB_sT24_timerdp_u1__DP_AUX_CTL_REG EQU CYREG_B0_UDB11_ACTL
millis_timer_TimerUDB_sT24_timerdp_u1__F0_F1_REG EQU CYREG_B0_UDB11_F0_F1
millis_timer_TimerUDB_sT24_timerdp_u1__F0_REG EQU CYREG_B0_UDB11_F0
millis_timer_TimerUDB_sT24_timerdp_u1__F1_REG EQU CYREG_B0_UDB11_F1
millis_timer_TimerUDB_sT24_timerdp_u1__MSK_DP_AUX_CTL_REG EQU CYREG_B0_UDB11_MSK_ACTL
millis_timer_TimerUDB_sT24_timerdp_u1__PER_DP_AUX_CTL_REG EQU CYREG_B0_UDB11_MSK_ACTL
millis_timer_TimerUDB_sT24_timerdp_u2__16BIT_A0_REG EQU CYREG_B0_UDB12_13_A0
millis_timer_TimerUDB_sT24_timerdp_u2__16BIT_A1_REG EQU CYREG_B0_UDB12_13_A1
millis_timer_TimerUDB_sT24_timerdp_u2__16BIT_D0_REG EQU CYREG_B0_UDB12_13_D0
millis_timer_TimerUDB_sT24_timerdp_u2__16BIT_D1_REG EQU CYREG_B0_UDB12_13_D1
millis_timer_TimerUDB_sT24_timerdp_u2__16BIT_DP_AUX_CTL_REG EQU CYREG_B0_UDB12_13_ACTL
millis_timer_TimerUDB_sT24_timerdp_u2__16BIT_F0_REG EQU CYREG_B0_UDB12_13_F0
millis_timer_TimerUDB_sT24_timerdp_u2__16BIT_F1_REG EQU CYREG_B0_UDB12_13_F1
millis_timer_TimerUDB_sT24_timerdp_u2__A0_A1_REG EQU CYREG_B0_UDB12_A0_A1
millis_timer_TimerUDB_sT24_timerdp_u2__A0_REG EQU CYREG_B0_UDB12_A0
millis_timer_TimerUDB_sT24_timerdp_u2__A1_REG EQU CYREG_B0_UDB12_A1
millis_timer_TimerUDB_sT24_timerdp_u2__D0_D1_REG EQU CYREG_B0_UDB12_D0_D1
millis_timer_TimerUDB_sT24_timerdp_u2__D0_REG EQU CYREG_B0_UDB12_D0
millis_timer_TimerUDB_sT24_timerdp_u2__D1_REG EQU CYREG_B0_UDB12_D1
millis_timer_TimerUDB_sT24_timerdp_u2__DP_AUX_CTL_REG EQU CYREG_B0_UDB12_ACTL
millis_timer_TimerUDB_sT24_timerdp_u2__F0_F1_REG EQU CYREG_B0_UDB12_F0_F1
millis_timer_TimerUDB_sT24_timerdp_u2__F0_REG EQU CYREG_B0_UDB12_F0
millis_timer_TimerUDB_sT24_timerdp_u2__F1_REG EQU CYREG_B0_UDB12_F1

/* time_refresh_isr */
time_refresh_isr__INTC_CLR_EN_REG EQU CYREG_NVIC_CLRENA0
time_refresh_isr__INTC_CLR_PD_REG EQU CYREG_NVIC_CLRPEND0
time_refresh_isr__INTC_MASK EQU 0x01
time_refresh_isr__INTC_NUMBER EQU 0
time_refresh_isr__INTC_PRIOR_NUM EQU 7
time_refresh_isr__INTC_PRIOR_REG EQU CYREG_NVIC_PRI_0
time_refresh_isr__INTC_SET_EN_REG EQU CYREG_NVIC_SETENA0
time_refresh_isr__INTC_SET_PD_REG EQU CYREG_NVIC_SETPEND0

/* time_refresh_timer_TimerUDB */
time_refresh_timer_TimerUDB_rstSts_stsreg__0__MASK EQU 0x01
time_refresh_timer_TimerUDB_rstSts_stsreg__0__POS EQU 0
time_refresh_timer_TimerUDB_rstSts_stsreg__2__MASK EQU 0x04
time_refresh_timer_TimerUDB_rstSts_stsreg__2__POS EQU 2
time_refresh_timer_TimerUDB_rstSts_stsreg__3__MASK EQU 0x08
time_refresh_timer_TimerUDB_rstSts_stsreg__3__POS EQU 3
time_refresh_timer_TimerUDB_rstSts_stsreg__MASK EQU 0x0D
time_refresh_timer_TimerUDB_rstSts_stsreg__MASK_REG EQU CYREG_B0_UDB15_MSK
time_refresh_timer_TimerUDB_rstSts_stsreg__MASK_ST_AUX_CTL_REG EQU CYREG_B0_UDB15_MSK_ACTL
time_refresh_timer_TimerUDB_rstSts_stsreg__PER_ST_AUX_CTL_REG EQU CYREG_B0_UDB15_MSK_ACTL
time_refresh_timer_TimerUDB_rstSts_stsreg__STATUS_AUX_CTL_REG EQU CYREG_B0_UDB15_ACTL
time_refresh_timer_TimerUDB_rstSts_stsreg__STATUS_CNT_REG EQU CYREG_B0_UDB15_ST_CTL
time_refresh_timer_TimerUDB_rstSts_stsreg__STATUS_CONTROL_REG EQU CYREG_B0_UDB15_ST_CTL
time_refresh_timer_TimerUDB_rstSts_stsreg__STATUS_REG EQU CYREG_B0_UDB15_ST
time_refresh_timer_TimerUDB_sCTRLReg_SyncCtl_ctrlreg__7__MASK EQU 0x80
time_refresh_timer_TimerUDB_sCTRLReg_SyncCtl_ctrlreg__7__POS EQU 7
time_refresh_timer_TimerUDB_sCTRLReg_SyncCtl_ctrlreg__CONTROL_AUX_CTL_REG EQU CYREG_B0_UDB15_ACTL
time_refresh_timer_TimerUDB_sCTRLReg_SyncCtl_ctrlreg__CONTROL_REG EQU CYREG_B0_UDB15_CTL
time_refresh_timer_TimerUDB_sCTRLReg_SyncCtl_ctrlreg__CONTROL_ST_REG EQU CYREG_B0_UDB15_ST_CTL
time_refresh_timer_TimerUDB_sCTRLReg_SyncCtl_ctrlreg__COUNT_REG EQU CYREG_B0_UDB15_CTL
time_refresh_timer_TimerUDB_sCTRLReg_SyncCtl_ctrlreg__COUNT_ST_REG EQU CYREG_B0_UDB15_ST_CTL
time_refresh_timer_TimerUDB_sCTRLReg_SyncCtl_ctrlreg__MASK EQU 0x80
time_refresh_timer_TimerUDB_sCTRLReg_SyncCtl_ctrlreg__MASK_CTL_AUX_CTL_REG EQU CYREG_B0_UDB15_MSK_ACTL
time_refresh_timer_TimerUDB_sCTRLReg_SyncCtl_ctrlreg__PER_CTL_AUX_CTL_REG EQU CYREG_B0_UDB15_MSK_ACTL
time_refresh_timer_TimerUDB_sCTRLReg_SyncCtl_ctrlreg__PERIOD_REG EQU CYREG_B0_UDB15_MSK
time_refresh_timer_TimerUDB_sT16_timerdp_u0__16BIT_A0_REG EQU CYREG_B0_UDB14_15_A0
time_refresh_timer_TimerUDB_sT16_timerdp_u0__16BIT_A1_REG EQU CYREG_B0_UDB14_15_A1
time_refresh_timer_TimerUDB_sT16_timerdp_u0__16BIT_D0_REG EQU CYREG_B0_UDB14_15_D0
time_refresh_timer_TimerUDB_sT16_timerdp_u0__16BIT_D1_REG EQU CYREG_B0_UDB14_15_D1
time_refresh_timer_TimerUDB_sT16_timerdp_u0__16BIT_DP_AUX_CTL_REG EQU CYREG_B0_UDB14_15_ACTL
time_refresh_timer_TimerUDB_sT16_timerdp_u0__16BIT_F0_REG EQU CYREG_B0_UDB14_15_F0
time_refresh_timer_TimerUDB_sT16_timerdp_u0__16BIT_F1_REG EQU CYREG_B0_UDB14_15_F1
time_refresh_timer_TimerUDB_sT16_timerdp_u0__A0_A1_REG EQU CYREG_B0_UDB14_A0_A1
time_refresh_timer_TimerUDB_sT16_timerdp_u0__A0_REG EQU CYREG_B0_UDB14_A0
time_refresh_timer_TimerUDB_sT16_timerdp_u0__A1_REG EQU CYREG_B0_UDB14_A1
time_refresh_timer_TimerUDB_sT16_timerdp_u0__D0_D1_REG EQU CYREG_B0_UDB14_D0_D1
time_refresh_timer_TimerUDB_sT16_timerdp_u0__D0_REG EQU CYREG_B0_UDB14_D0
time_refresh_timer_TimerUDB_sT16_timerdp_u0__D1_REG EQU CYREG_B0_UDB14_D1
time_refresh_timer_TimerUDB_sT16_timerdp_u0__DP_AUX_CTL_REG EQU CYREG_B0_UDB14_ACTL
time_refresh_timer_TimerUDB_sT16_timerdp_u0__F0_F1_REG EQU CYREG_B0_UDB14_F0_F1
time_refresh_timer_TimerUDB_sT16_timerdp_u0__F0_REG EQU CYREG_B0_UDB14_F0
time_refresh_timer_TimerUDB_sT16_timerdp_u0__F1_REG EQU CYREG_B0_UDB14_F1
time_refresh_timer_TimerUDB_sT16_timerdp_u1__A0_A1_REG EQU CYREG_B0_UDB15_A0_A1
time_refresh_timer_TimerUDB_sT16_timerdp_u1__A0_REG EQU CYREG_B0_UDB15_A0
time_refresh_timer_TimerUDB_sT16_timerdp_u1__A1_REG EQU CYREG_B0_UDB15_A1
time_refresh_timer_TimerUDB_sT16_timerdp_u1__D0_D1_REG EQU CYREG_B0_UDB15_D0_D1
time_refresh_timer_TimerUDB_sT16_timerdp_u1__D0_REG EQU CYREG_B0_UDB15_D0
time_refresh_timer_TimerUDB_sT16_timerdp_u1__D1_REG EQU CYREG_B0_UDB15_D1
time_refresh_timer_TimerUDB_sT16_timerdp_u1__DP_AUX_CTL_REG EQU CYREG_B0_UDB15_ACTL
time_refresh_timer_TimerUDB_sT16_timerdp_u1__F0_F1_REG EQU CYREG_B0_UDB15_F0_F1
time_refresh_timer_TimerUDB_sT16_timerdp_u1__F0_REG EQU CYREG_B0_UDB15_F0
time_refresh_timer_TimerUDB_sT16_timerdp_u1__F1_REG EQU CYREG_B0_UDB15_F1
time_refresh_timer_TimerUDB_sT16_timerdp_u1__MSK_DP_AUX_CTL_REG EQU CYREG_B0_UDB15_MSK_ACTL
time_refresh_timer_TimerUDB_sT16_timerdp_u1__PER_DP_AUX_CTL_REG EQU CYREG_B0_UDB15_MSK_ACTL

/* Miscellaneous */
BCLK__BUS_CLK__HZ EQU 24000000
BCLK__BUS_CLK__KHZ EQU 24000
BCLK__BUS_CLK__MHZ EQU 24
CYDEV_CHIP_DIE_LEOPARD EQU 1
CYDEV_CHIP_DIE_PSOC4A EQU 12
CYDEV_CHIP_DIE_PSOC5LP EQU 19
CYDEV_CHIP_DIE_PSOC5TM EQU 20
CYDEV_CHIP_DIE_TMA4 EQU 2
CYDEV_CHIP_DIE_UNKNOWN EQU 0
CYDEV_CHIP_FAMILY_FM0P EQU 4
CYDEV_CHIP_FAMILY_FM3 EQU 5
CYDEV_CHIP_FAMILY_FM4 EQU 6
CYDEV_CHIP_FAMILY_PSOC3 EQU 1
CYDEV_CHIP_FAMILY_PSOC4 EQU 2
CYDEV_CHIP_FAMILY_PSOC5 EQU 3
CYDEV_CHIP_FAMILY_UNKNOWN EQU 0
CYDEV_CHIP_FAMILY_USED EQU CYDEV_CHIP_FAMILY_PSOC5
CYDEV_CHIP_JTAG_ID EQU 0x2E123069
CYDEV_CHIP_MEMBER_3A EQU 1
CYDEV_CHIP_MEMBER_4A EQU 12
CYDEV_CHIP_MEMBER_4C EQU 18
CYDEV_CHIP_MEMBER_4D EQU 8
CYDEV_CHIP_MEMBER_4E EQU 4
CYDEV_CHIP_MEMBER_4F EQU 13
CYDEV_CHIP_MEMBER_4G EQU 2
CYDEV_CHIP_MEMBER_4H EQU 11
CYDEV_CHIP_MEMBER_4I EQU 17
CYDEV_CHIP_MEMBER_4J EQU 9
CYDEV_CHIP_MEMBER_4K EQU 10
CYDEV_CHIP_MEMBER_4L EQU 16
CYDEV_CHIP_MEMBER_4M EQU 15
CYDEV_CHIP_MEMBER_4N EQU 6
CYDEV_CHIP_MEMBER_4O EQU 5
CYDEV_CHIP_MEMBER_4P EQU 14
CYDEV_CHIP_MEMBER_4Q EQU 7
CYDEV_CHIP_MEMBER_4U EQU 3
CYDEV_CHIP_MEMBER_5A EQU 20
CYDEV_CHIP_MEMBER_5B EQU 19
CYDEV_CHIP_MEMBER_FM3 EQU 24
CYDEV_CHIP_MEMBER_FM4 EQU 25
CYDEV_CHIP_MEMBER_PDL_FM0P_TYPE1 EQU 21
CYDEV_CHIP_MEMBER_PDL_FM0P_TYPE2 EQU 22
CYDEV_CHIP_MEMBER_PDL_FM0P_TYPE3 EQU 23
CYDEV_CHIP_MEMBER_UNKNOWN EQU 0
CYDEV_CHIP_MEMBER_USED EQU CYDEV_CHIP_MEMBER_5B
CYDEV_CHIP_DIE_EXPECT EQU CYDEV_CHIP_MEMBER_USED
CYDEV_CHIP_DIE_ACTUAL EQU CYDEV_CHIP_DIE_EXPECT
CYDEV_CHIP_REV_LEOPARD_ES1 EQU 0
CYDEV_CHIP_REV_LEOPARD_ES2 EQU 1
CYDEV_CHIP_REV_LEOPARD_ES3 EQU 3
CYDEV_CHIP_REV_LEOPARD_PRODUCTION EQU 3
CYDEV_CHIP_REV_PSOC4A_ES0 EQU 17
CYDEV_CHIP_REV_PSOC4A_PRODUCTION EQU 17
CYDEV_CHIP_REV_PSOC5LP_ES0 EQU 0
CYDEV_CHIP_REV_PSOC5LP_PRODUCTION EQU 0
CYDEV_CHIP_REV_PSOC5TM_ES0 EQU 0
CYDEV_CHIP_REV_PSOC5TM_ES1 EQU 1
CYDEV_CHIP_REV_PSOC5TM_PRODUCTION EQU 1
CYDEV_CHIP_REV_TMA4_ES EQU 17
CYDEV_CHIP_REV_TMA4_ES2 EQU 33
CYDEV_CHIP_REV_TMA4_PRODUCTION EQU 17
CYDEV_CHIP_REVISION_3A_ES1 EQU 0
CYDEV_CHIP_REVISION_3A_ES2 EQU 1
CYDEV_CHIP_REVISION_3A_ES3 EQU 3
CYDEV_CHIP_REVISION_3A_PRODUCTION EQU 3
CYDEV_CHIP_REVISION_4A_ES0 EQU 17
CYDEV_CHIP_REVISION_4A_PRODUCTION EQU 17
CYDEV_CHIP_REVISION_4C_PRODUCTION EQU 0
CYDEV_CHIP_REVISION_4D_PRODUCTION EQU 0
CYDEV_CHIP_REVISION_4E_PRODUCTION EQU 0
CYDEV_CHIP_REVISION_4F_PRODUCTION EQU 0
CYDEV_CHIP_REVISION_4F_PRODUCTION_256DMA EQU 0
CYDEV_CHIP_REVISION_4F_PRODUCTION_256K EQU 0
CYDEV_CHIP_REVISION_4G_ES EQU 17
CYDEV_CHIP_REVISION_4G_ES2 EQU 33
CYDEV_CHIP_REVISION_4G_PRODUCTION EQU 17
CYDEV_CHIP_REVISION_4H_PRODUCTION EQU 0
CYDEV_CHIP_REVISION_4I_PRODUCTION EQU 0
CYDEV_CHIP_REVISION_4J_PRODUCTION EQU 0
CYDEV_CHIP_REVISION_4K_PRODUCTION EQU 0
CYDEV_CHIP_REVISION_4L_PRODUCTION EQU 0
CYDEV_CHIP_REVISION_4M_PRODUCTION EQU 0
CYDEV_CHIP_REVISION_4N_PRODUCTION EQU 0
CYDEV_CHIP_REVISION_4O_PRODUCTION EQU 0
CYDEV_CHIP_REVISION_4P_PRODUCTION EQU 0
CYDEV_CHIP_REVISION_4Q_PRODUCTION EQU 0
CYDEV_CHIP_REVISION_4U_PRODUCTION EQU 0
CYDEV_CHIP_REVISION_5A_ES0 EQU 0
CYDEV_CHIP_REVISION_5A_ES1 EQU 1
CYDEV_CHIP_REVISION_5A_PRODUCTION EQU 1
CYDEV_CHIP_REVISION_5B_ES0 EQU 0
CYDEV_CHIP_REVISION_5B_PRODUCTION EQU 0
CYDEV_CHIP_REVISION_FM3_PRODUCTION EQU 0
CYDEV_CHIP_REVISION_FM4_PRODUCTION EQU 0
CYDEV_CHIP_REVISION_PDL_FM0P_TYPE1_PRODUCTION EQU 0
CYDEV_CHIP_REVISION_PDL_FM0P_TYPE2_PRODUCTION EQU 0
CYDEV_CHIP_REVISION_PDL_FM0P_TYPE3_PRODUCTION EQU 0
CYDEV_CHIP_REVISION_USED EQU CYDEV_CHIP_REVISION_5B_PRODUCTION
CYDEV_CHIP_REV_EXPECT EQU CYDEV_CHIP_REVISION_USED
CYDEV_CONFIG_FASTBOOT_ENABLED EQU 1
CYDEV_CONFIG_UNUSED_IO_AllowButWarn EQU 0
CYDEV_CONFIG_UNUSED_IO EQU CYDEV_CONFIG_UNUSED_IO_AllowButWarn
CYDEV_CONFIG_UNUSED_IO_AllowWithInfo EQU 1
CYDEV_CONFIG_UNUSED_IO_Disallowed EQU 2
CYDEV_CONFIGURATION_COMPRESSED EQU 1
CYDEV_CONFIGURATION_DMA EQU 0
CYDEV_CONFIGURATION_ECC EQU 1
CYDEV_CONFIGURATION_IMOENABLED EQU CYDEV_CONFIG_FASTBOOT_ENABLED
CYDEV_CONFIGURATION_MODE_COMPRESSED EQU 0
CYDEV_CONFIGURATION_MODE EQU CYDEV_CONFIGURATION_MODE_COMPRESSED
CYDEV_CONFIGURATION_MODE_DMA EQU 2
CYDEV_CONFIGURATION_MODE_UNCOMPRESSED EQU 1
CYDEV_DEBUG_ENABLE_MASK EQU 0x20
CYDEV_DEBUG_ENABLE_REGISTER EQU CYREG_MLOGIC_DEBUG
CYDEV_DEBUGGING_DPS_Disable EQU 3
CYDEV_DEBUGGING_DPS_JTAG_4 EQU 1
CYDEV_DEBUGGING_DPS_JTAG_5 EQU 0
CYDEV_DEBUGGING_DPS_SWD EQU 2
CYDEV_DEBUGGING_DPS_SWD_SWV EQU 6
CYDEV_DEBUGGING_DPS EQU CYDEV_DEBUGGING_DPS_SWD_SWV
CYDEV_DEBUGGING_ENABLE EQU 1
CYDEV_DEBUGGING_XRES EQU 0
CYDEV_DMA_CHANNELS_AVAILABLE EQU 24
CYDEV_ECC_ENABLE EQU 0
CYDEV_HEAP_SIZE EQU 0x80
CYDEV_INSTRUCT_CACHE_ENABLED EQU 1
CYDEV_INTR_RISING EQU 0x00008001
CYDEV_IS_EXPORTING_CODE EQU 0
CYDEV_IS_IMPORTING_CODE EQU 0
CYDEV_PROJ_TYPE EQU 0
CYDEV_PROJ_TYPE_BOOTLOADER EQU 1
CYDEV_PROJ_TYPE_LAUNCHER EQU 5
CYDEV_PROJ_TYPE_LOADABLE EQU 2
CYDEV_PROJ_TYPE_LOADABLEANDBOOTLOADER EQU 4
CYDEV_PROJ_TYPE_MULTIAPPBOOTLOADER EQU 3
CYDEV_PROJ_TYPE_STANDARD EQU 0
CYDEV_PROTECTION_ENABLE EQU 0
CYDEV_STACK_SIZE EQU 0x0800
CYDEV_USE_BUNDLED_CMSIS EQU 1
CYDEV_VARIABLE_VDDA EQU 0
CYDEV_VDDA_MV EQU 5000
CYDEV_VDDD_MV EQU 5000
CYDEV_VDDIO0_MV EQU 5000
CYDEV_VDDIO1_MV EQU 5000
CYDEV_VDDIO2_MV EQU 5000
CYDEV_VDDIO3_MV EQU 5000
CYDEV_VIO0_MV EQU 5000
CYDEV_VIO1_MV EQU 5000
CYDEV_VIO2_MV EQU 5000
CYDEV_VIO3_MV EQU 5000
CYIPBLOCK_ARM_CM3_VERSION EQU 0
CYIPBLOCK_P3_ANAIF_VERSION EQU 0
CYIPBLOCK_P3_CAN_VERSION EQU 0
CYIPBLOCK_P3_CAPSENSE_VERSION EQU 0
CYIPBLOCK_P3_COMP_VERSION EQU 0
CYIPBLOCK_P3_DECIMATOR_VERSION EQU 0
CYIPBLOCK_P3_DFB_VERSION EQU 0
CYIPBLOCK_P3_DMA_VERSION EQU 0
CYIPBLOCK_P3_DRQ_VERSION EQU 0
CYIPBLOCK_P3_DSM_VERSION EQU 0
CYIPBLOCK_P3_EMIF_VERSION EQU 0
CYIPBLOCK_P3_I2C_VERSION EQU 0
CYIPBLOCK_P3_LCD_VERSION EQU 0
CYIPBLOCK_P3_LPF_VERSION EQU 0
CYIPBLOCK_P3_OPAMP_VERSION EQU 0
CYIPBLOCK_P3_PM_VERSION EQU 0
CYIPBLOCK_P3_SCCT_VERSION EQU 0
CYIPBLOCK_P3_TIMER_VERSION EQU 0
CYIPBLOCK_P3_USB_VERSION EQU 0
CYIPBLOCK_P3_VIDAC_VERSION EQU 0
CYIPBLOCK_P3_VREF_VERSION EQU 0
CYIPBLOCK_S8_GPIO_VERSION EQU 0
CYIPBLOCK_S8_IRQ_VERSION EQU 0
CYIPBLOCK_S8_SAR_VERSION EQU 0
CYIPBLOCK_S8_SIO_VERSION EQU 0
CYIPBLOCK_S8_UDB_VERSION EQU 0
DMA_CHANNELS_USED__MASK0 EQU 0x00000000
CYDEV_BOOTLOADER_ENABLE EQU 0

#endif /* INCLUDED_CYFITTERIAR_INC */
